## build_scripts/buildroot/Config.in
```kconfig
source "$BR2_EXTERNAL_AD5M_PATH/package/python-mido-custom/Config.in"
source "$BR2_EXTERNAL_AD5M_PATH/package/python-ff-ad5m-audio-custom/Config.in"
source "$BR2_EXTERNAL_AD5M_PATH/package/python-ff-ad5m-backlight-custom/Config.in"
source "$BR2_EXTERNAL_AD5M_PATH/package/ustreamer-custom/Config.in"
source "$BR2_EXTERNAL_AD5M_PATH/package/guppyscreen-custom/Config.in"
source "$BR2_EXTERNAL_AD5M_PATH/package/libdom-custom/Config.in"
source "$BR2_EXTERNAL_AD5M_PATH/package/libhubbub-custom/Config.in"
source "$BR2_EXTERNAL_AD5M_PATH/package/libparserutils-custom/Config.in"
source "$BR2_EXTERNAL_AD5M_PATH/package/libwapcaplet-custom/Config.in"
source "$BR2_EXTERNAL_AD5M_PATH/package/libsvgtiny-ad5m/Config.in"
source "$BR2_EXTERNAL_AD5M_PATH/package/libsvgtiny-pixbuf/Config.in"
```
